/*********************************************************************************************************
* 模块名称：Main.c
* 摘    要：主文件，包含软硬件初始化函数和main函数
* 当前版本：1.0.0
* 作    者：Leyutek(COPYRIGHT 2018 - 2021 Leyutek. All rights reserved.)
* 完成日期：2021年07月01日
* 内    容：
* 注    意：注意勾选Options for Target 'Target1'->Code Generation->Use MicroLIB使printf功能生效                                                                  
**********************************************************************************************************
* 取代版本：
* 作    者：
* 完成日期：
* 修改内容：
* 修改文件：
**********************************************************************************************************/

/*********************************************************************************************************
*                                              包含头文件
**********************************************************************************************************/
#include "Main.h"
#include "gd32f30x_conf.h"
#include "SysTick.h"
#include "RCU.h"
#include "NVIC.h"
#include "Timer.h"
#include "UART0.h"
#include "LED.h"
#include "KeyOne.h"
#include "ProcKeyOne.h"
#include "DataType.h"

/*********************************************************************************************************
*                                              宏定义
**********************************************************************************************************/

/*********************************************************************************************************
*                                              枚举结构体
**********************************************************************************************************/

/*********************************************************************************************************
*                                              内部变量声明
**********************************************************************************************************/
static u8 led_g_state = 0;
static u8 led_y_state = 0;
static u8 led_r_state = 0;

/*********************************************************************************************************
*                                              内部函数声明
**********************************************************************************************************/
static  void  InitSoftware(void);   /* 初始化软件模块，在初始化硬件之后调用此函数 */
static  void  InitHardware(void);   /* 初始化硬件模块，在系统启动时调用此函数 */
static  void  Proc2msTask(void);    /* 2ms周期处理任务 */
static  void  Proc1SecTask(void);   /* 1s周期处理任务 */

/*********************************************************************************************************
*                                              内部函数实现
**********************************************************************************************************/
/*********************************************************************************************************
* 函数名称：InitSoftware
* 函数功能：初始化软件模块，在初始化硬件之后调用此函数
* 输入参数：void
* 输出参数：void
* 返 回 值：void
* 完成日期：2021年07月01日
* 注    意：
**********************************************************************************************************/
static  void  InitSoftware(void)
{

}

/*********************************************************************************************************
* 函数名称：InitHardware
* 函数功能：初始化硬件模块，在系统启动时调用此函数
* 输入参数：void
* 输出参数：void
* 返 回 值：void
* 完成日期：2021年07月01日
* 注    意：
**********************************************************************************************************/
static  void  InitHardware(void)
{  
  SystemInit();        /* 系统初始化 */
  InitRCU();           /* 初始化RCU模块 */
  InitNVIC();          /* 初始化NVIC模块 */  
  InitUART0(115200);   /* 初始化UART模块 */
  InitTimer();         /* 初始化Timer模块 */
  InitLED();           /* 初始化LED模块 */
  InitSysTick();       /* 初始化SysTick模块 */
  InitKeyOne();        /* 初始化KeyOne模块 */
  InitProcKeyOne();    /* 初始化ProcKeyOne模块 */
}

/*********************************************************************************************************
* 函数名称：Proc2msTask
* 函数功能：2ms周期处理任务 
* 输入参数：void
* 输出参数：void
* 返 回 值：void
* 完成日期：2021年07月01日
* 注    意：
**********************************************************************************************************/
static  void  Proc2msTask(void)
{  
  static signed short s_iCnt5 = 0;
  
  if(Get2msFlag())  /* 检查2ms标志状态 */
  { 
    /* LEDFlicker(250); */  /* 闪烁LED控制 */     

    if(s_iCnt5 >= 4)
    { 
      ScanKeyOne(KEY_NAME_KEY1, ProcKeyUpKey1, ProcKeyDownKey1);
      ScanKeyOne(KEY_NAME_KEY2, ProcKeyUpKey2, ProcKeyDownKey2);
      ScanKeyOne(KEY_NAME_KEY3, ProcKeyUpKey3, ProcKeyDownKey3);

      s_iCnt5 = 0;
    }
    else
    {
      s_iCnt5++;
    }     
       
    Clr2msFlag();   /* 清除2ms标志 */
  }
}

/*********************************************************************************************************
* 函数名称：Proc1SecTask
* 函数功能：1s周期处理任务 
* 输入参数：void
* 输出参数：void
* 返 回 值：void
* 完成日期：2021年07月01日
* 注    意：
**********************************************************************************************************/
static  void  Proc1SecTask(void)
{ 
  if(Get1SecFlag()) /* 检查1s标志状态 */
  {
    /* printf("This is the first GD32F303 Project, by Zhangsan\r\n"); */
    /* LEDFlicker(250); */  /* 闪烁LED控制 */
    Clr1SecFlag();  /* 清除1s标志 */
  }    
}

/*********************************************************************************************************
* 函数名称：main
* 函数功能：主函数 
* 输入参数：void
* 输出参数：void
* 返 回 值：int
* 完成日期：2021年07月01日
* 注    意：
**********************************************************************************************************/
int main(void)
{
  InitHardware();   /* 初始化硬件外设模块 */
  InitSoftware();   /* 初始化软件模块 */

  printf("Init System has been finished.\r\n" );  /* 打印系统状态 */
  
  while(1)
  {
    if(key_scan(KEY_G_PORT, KEY_G_PIN) == 1)
    {
      led_toggle(LED_G_PORT, LED_G_PIN, &led_g_state);
    }

    if(key_scan(KEY_Y_PORT, KEY_Y_PIN) == 1)
    {
      led_toggle(LED_Y_PORT, LED_Y_PIN, &led_y_state);
    }

    if(key_scan(KEY_R_PORT, KEY_R_PIN) == 1)
    {
      led_toggle(LED_R_PORT, LED_R_PIN, &led_r_state);
    }

    DelayNms(10);
  }
}
